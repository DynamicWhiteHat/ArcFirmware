## boards/arm/arc/Kconfig.defconfig
```kconfig
if BOARD_ARC

config ZMK_KEYBOARD_NAME
    default "Arc"

config BOARD
    default "arc"

config BT_CTLR
    default BT

config ZMK_MAX17048
    default y

if USB

config USB_NRFX
    default y

config USB_DEVICE_STACK
    default y

endif # USB
endif # BOARD_ARC
```

## boards/arm/arc/board.yml
```yaml
board:
  name: arc
  vendor: DynamicWhiteHat
  socs:
    - name: nrf52840
      variants:
        - name: zmk
```

## config/west.yml
```yaml
manifest:
  defaults:
    revision: v0.3.0
  remotes:
    - name: zmkfirmware
      url-base: https://github.com/zmkfirmware
    - name: view
      url-base: https://github.com/DynamicWhiteHat
  projects:
    - name: zmk
      remote: zmkfirmware
      import: app/west.yml
    - name: nice-view-gem-rotated
      remote: view
      revision: main
  self:
    path: config
```
